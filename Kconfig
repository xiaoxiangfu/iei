## Kconfig
```kconfig
# SPDX-License-Identifier: GPL
config SECURITY_IEI
       bool "IEI Linux Security Module"
       depends on SECURITY
       select SECURITYFS
       help
         IEI(Inode-bound Execution Integrity) is a
	 simple Linux Security Module for experimental
	 and research purposes.
```

## Kconfig.diff
```kconfig
diff --git a/security/Kconfig b/security/Kconfig
index 7ac95684ac7b..535594ea59da 100644
--- a/security/Kconfig
+++ b/security/Kconfig
@@ -195,6 +195,7 @@ source "security/safesetid/Kconfig"
 source "security/lockdown/Kconfig"
 source "security/landlock/Kconfig"
 source "security/ztlsm/Kconfig"
+source "security/iei/Kconfig"
 
 source "security/integrity/Kconfig"
 
```
